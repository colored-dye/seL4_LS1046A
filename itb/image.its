## itb/image.its
```
/dts-v1/;

/ {
    description = "Image with an ElfLoader, a seL4 kernel, and a user application";
    #address-cells = <1>;
    images {
        seL4Kernel {
            description = "ElfLoader";
            data = /incbin/("../build/apps/hello/images/hello-world-image-arm-ls1046a");
            type = "kernel";
            arch = "arm64";
            os = "qnx";
            compression = "none";
            load = <0x80664000>;
            entry = <0x80664000>;
        };
        // seL4fdt {
        //     description = "DTB";
        //     data = /incbin/("../build/apps/hello/kernel/kernel.dtb");
        //     type = "flat_dt";
        //     arch = "arm64";
        //     compression = "none";
        // };
    };
    configurations {
        default = "standard";
        standard {
            description = "Boot ElfLoader and then kernel";
            kernel = "seL4Kernel";
            // fdt = "seL4fdt";
        };
    };
};
```
